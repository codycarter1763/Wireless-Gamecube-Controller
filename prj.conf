## CMakeLists.txt
```
cmake_minimum_required(VERSION 3.20.0)

find_package(Zephyr REQUIRED HINTS $ENV{ZEPHYR_BASE})
project(nrf_gc_wireless)

target_sources(app PRIVATE src/main.c src/radio.c src/gc_logic.c)
target_sources_ifdef(CONFIG_APP_ROLE_PTX app PRIVATE src/ptx.c src/joybus.c)
target_sources_ifdef(CONFIG_APP_ROLE_PRX app PRIVATE src/prx.c src/joybus_target.c)
```

## Kconfig
```
# Bigger stacks than Zephyr's defaults: the stats printout (snprintf +
# several long printk calls) overflowed the 1 KB main stack, which trips the
# stack guard and halts the CPU. These must come before Kconfig.zephyr.
config MAIN_STACK_SIZE
	default 4096

config SYSTEM_WORKQUEUE_STACK_SIZE
	default 2048

source "Kconfig.zephyr"

menu "Wireless GameCube controller"

# Pull in everything the app needs from Kconfig itself, so the build works
# even if prj.conf is not picked up.
config APP_ESB_LINK
	bool
	default y
	select GPIO
	select CLOCK_CONTROL
	select ESB
	# The receiver lets ESB keep the HF crystal on. The controller manages
	# it itself so it can switch it off between sends while dozing.
	select ESB_CLOCK_INIT if APP_ROLE_PRX
	select POWEROFF if APP_ROLE_PTX

choice APP_ROLE
	prompt "Board role"
	default APP_ROLE_PTX

config APP_ROLE_PTX
	bool "PTX - controller board (reads the real pad, sends inputs)"

config APP_ROLE_PRX
	bool "PRX - receiver board (plugs into the console)"

endchoice

config GC_DATA_PIN
	int "Joybus data pin (P0.x)"
	default 20
	range 0 31
	help
	  GC data line (pin 2 on the plug), on both boards.
	  Controller board: needs an external 1k pull-up to 3.3V.
	  Receiver board: no pull-up; the console provides it.
	  Default P0.20 = pin D3 on Pro Micro nRF52840 boards.
	  Port 0 only. Avoid P0.09/P0.10 (NFC pins).

config GC_RX_NO_SLEEP
	bool "Receiver: never let the CPU sleep"
	default y
	depends on APP_ROLE_PRX
	help
	  Runs a lowest-priority busy loop so the CPU never enters WFI idle.
	  Waking from idle delays the Joybus command ISR by several us, which
	  is enough to miss the first console bits. Costs a few mA, which
	  doesn't matter on the USB/console-powered receiver.

config APP_POLL_INTERVAL_US
	int "Pad poll interval while active (us)"
	default 1000
	depends on APP_ROLE_PTX
	help
	  How often the controller board polls the pad while you're playing.
	  One poll + send takes about 800 us, so keep this at 1000 or above.
	  2000 roughly halves the polling cost for at most 1 ms more lag.

menu "Controller power saving"
	depends on APP_ROLE_PTX

config APP_POLL_SLOW_US
	int "Pad poll interval while active but nothing is changing (us)"
	default 4000
	help
	  Adaptive poll rate: poll at APP_POLL_INTERVAL_US while the input is
	  changing, and drop to this rate after APP_FAST_HOLD_MS with no
	  change. The first change seen switches straight back to the fast
	  rate, so only that first change waits up to this interval (4 ms by
	  default, well under one 16.7 ms frame). Each poll keeps the CPU busy
	  for ~370 us, so 4000 cuts idle-hands polling cost by ~75%.
	  Set equal to APP_POLL_INTERVAL_US to always poll fast.

config APP_FAST_HOLD_MS
	int "Stay at the fast poll rate this long after the last change (ms)"
	default 100

config APP_FAST_THRESH
	int "Stick/trigger movement that selects the fast rate"
	default 3
	range 1 20
	help
	  Button changes always select the fast rate. Analog values are
	  compared with their value at the last real change, so this must be
	  larger than the sensor noise's full range: 3 for a stick that wobbles
	  +-1 at rest, 5 for a worn one that wobbles +-2. Too low and a
	  resting pad stays at 1 kHz.

config APP_KEEPALIVE_MS
	int "Send at least every N ms, even if nothing changed"
	default 20
	help
	  Input is only sent when it changes, plus this keepalive. Must stay
	  well under the receiver's APP_RX_STALE_MS (250 ms), after which the
	  console sees a neutral controller: with 20 ms, about a dozen packets
	  in a row must be lost before control drops.

config APP_ANALOG_DEADBAND
	int "Stick/trigger change that counts as new input"
	default 1
	range 1 20
	help
	  1 sends every analog change (most precise). 2-3 ignores sensor noise
	  on worn sticks, so fewer packets are sent while the pad sits still.

config APP_ACTIVITY_THRESH
	int "Stick/trigger movement that counts as 'someone is playing'"
	default 12
	help
	  Button presses always count. Analog changes smaller than this
	  (sensor noise, a resting thumb) don't reset the idle timers.

config APP_DOZE_S
	int "Seconds without activity before dozing (0 = never)"
	default 60
	help
	  Doze: poll the pad at a low rate, HF crystal off between sends,
	  status LED off. Any activity switches straight back to full rate.

config APP_DOZE_POLL_MS
	int "Pad poll interval while dozing (ms)"
	default 16

config APP_SLEEP_MIN
	int "Minutes without activity before powering off (0 = never)"
	default 10
	help
	  Power off: pad power (VCC) cut, nRF in System OFF (~a few uA).
	  Wake with one press of the reset button, or GC_WAKE_PIN.

config APP_LINK_LOSS_MS
	int "No acknowledged packet for this long -> link counts as lost (ms)"
	default 1000
	help
	  While the link is lost, the controller stops sending on every input
	  change and only probes every APP_LINK_PROBE_MS, until a probe is
	  acknowledged. Time-based, so a burst of failures on a lossy link
	  doesn't switch to probing while packets are still getting through.

config APP_LINK_PROBE_MS
	int "Probe interval while the link is lost (ms)"
	default 100

config APP_LINK_LOST_SLEEP_MIN
	int "Minutes without a receiver before powering off (0 = never)"
	default 5
	help
	  Powers off even while buttons are being pressed: without a receiver
	  the controller can't do anything useful.

config GC_VCC_CTRL_PIN
	int "VCC switch control pin (P0.x, -1 = board has none)"
	default 13
	range -1 31
	help
	  Pro Micro nRF52840 / nice!nano boards switch their VCC pin's 3.3V
	  with P0.13. The pad is powered from VCC, so turning it off cuts the
	  pad's power while the board sleeps.

config GC_VCC_ON_HIGH
	bool "VCC is on when the control pin is high"
	default y
	help
	  y: SuperMini / nice!nano v2 clones (low = VCC off).
	  n: original nice!nano v1 (high = VCC off).

config GC_WAKE_PIN
	int "Optional wake button pin (P0.x, button to GND; -1 = reset only)"
	default -1
	range -1 31

config APP_OTA_COMBO
	bool "Button combo reboots into the Bluetooth (OTA) bootloader"
	default y
	help
	  Hold L + R + Z + A (both triggers fully clicked) for APP_OTA_HOLD_MS
	  and the controller reboots into the Adafruit bootloader's OTA mode.
	  It then advertises over Bluetooth as "AdaDFU"; send it a DFU package
	  (gc_controller_ota.zip from CI) with the nRF Connect or nRF Toolbox
	  phone app. The bootloader stays in OTA mode until it's updated or
	  reset/power-cycled.

config APP_OTA_HOLD_MS
	int "How long the OTA combo must be held (ms)"
	default 5000
	depends on APP_OTA_COMBO

config APP_STATUS_LED
	bool "Status LED pulse while connected"
	default y
	help
	  A 20 ms pulse every 2 s while active. Off while dozing.

config APP_RTT_STATS
	bool "Measure radio round-trip time (keeps a 1 MHz timer running)"
	default y

endmenu

config APP_RF_CHANNEL
	int "ESB RF channel (2400 + n MHz)"
	default 76
	range 0 100
	help
	  76 = 2476 MHz: above Wi-Fi channel 11 and below BLE advertising
	  channel 39 (2480 MHz). Must match on both boards.

config APP_RETRANSMIT_DELAY_US
	int "ESB retransmit delay (us)"
	default 500
	range 435 4000
	help
	  Time between retries when no ACK arrives. ESB rejects anything below
	  435 us (esb_init() returns -EINVAL). Must match on both sides.

config APP_RETRANSMIT_COUNT
	int "ESB retransmit count"
	default 8
	range 0 15
	help
	  Extra attempts when no ACK arrives. On a lossy link (hands, body or
	  the console in the way) more retries make a big difference: with a
	  50% chance per attempt, 3 retries lose ~6% of packets, 8 lose ~0.2%.
	  Retries only happen when an attempt fails, so this costs nothing on a
	  good link.

config APP_TX_POWER
	int "Radio TX power (dBm)"
	default 8
	help
	  Valid on nRF52840: -40, -20, -16, -12, -8, -4, 0, 2, 3, 4, 5, 6, 7, 8.
	  +8 costs ~10 mA more only while actually transmitting (~90 us per
	  packet), i.e. well under 1 mA on average, and buys ~8 dB of link
	  margin. Applies to both boards (the receiver transmits the ACKs).

config APP_RX_STALE_MS
	int "Receiver: no packet for this long -> console sees neutral (ms)"
	default 250
	depends on APP_ROLE_PRX
	help
	  Safety net if the controller dies or goes out of range. Must be well
	  above the controller's keepalive (APP_KEEPALIVE_MS, 20 ms) so a few
	  lost packets in a row don't drop control.

config APP_DEBUG_PIN
	int "Debug GPIO (P0.x) for scope / logic analyzer"
	default 17
	range 0 31
	help
	  PTX: high from esb_write_payload() until TX success/fail.
	  PRX: short pulse each time a packet is received.
	  Default P0.17 (pin D2 on Pro Micro nRF52840 boards).

endmenu
```

## prj.conf
```kconfig
# The app's Kconfig already selects ESB, clock control and GPIO, so this
# file is optional. Put extra settings here (e.g. logging, TX power tweaks).
CONFIG_PRINTK=y
```

## debug.conf
```kconfig
# Debug add-on for the controller: USB serial console + radio round-trip
# stats. Add after ptx.conf:
#   -DEXTRA_CONF_FILE="ptx.conf;debug.conf"
# Draws more power (USB stack, stats timer); don't use it on battery.
CONFIG_BOARD_SERIAL_BACKEND_CDC_ACM=y
CONFIG_USB_DEVICE_STACK_NEXT=y
CONFIG_SERIAL=y
CONFIG_CONSOLE=y
CONFIG_UART_CONSOLE=y
CONFIG_APP_RTT_STATS=y
```

## lowpower.conf
```kconfig
# Battery build for the controller board: add after ptx.conf, e.g.
#   -DEXTRA_CONF_FILE="ptx.conf;lowpower.conf"
# No USB console (the USB stack and CDC ACM serial port are left out
# entirely), no logging, no RTT stats timer.
CONFIG_BOARD_SERIAL_BACKEND_CDC_ACM=n
CONFIG_USB_DEVICE_STACK_NEXT=n
CONFIG_SERIAL=n
CONFIG_CONSOLE=n
CONFIG_UART_CONSOLE=n
CONFIG_LOG=n
CONFIG_APP_RTT_STATS=n
```

## prx.conf
```kconfig
CONFIG_APP_ROLE_PRX=y
```

## ptx.conf
```kconfig
# Controller board (PTX). This is the battery build by default: no USB
# stack or serial console, no RTT stats timer.
# For serial output while developing, add debug.conf after this file:
#   -DEXTRA_CONF_FILE="ptx.conf;debug.conf"
CONFIG_APP_ROLE_PTX=y

CONFIG_BOARD_SERIAL_BACKEND_CDC_ACM=n
CONFIG_USB_DEVICE_STACK_NEXT=n
CONFIG_SERIAL=n
CONFIG_CONSOLE=n
CONFIG_UART_CONSOLE=n
CONFIG_LOG=n
CONFIG_APP_RTT_STATS=n
```

## src/main.c
```c
/*
 * ESB link test for the wireless GameCube controller.
 * Board: promicro_nrf52840/nrf52840/uf2. Role is chosen at build time
 * (ptx.conf / prx.conf).
 */
#include <zephyr/kernel.h>
#include <zephyr/fatal.h>
#include <zephyr/drivers/gpio.h>
#include <hal/nrf_gpio.h>
#include <nrfx.h>
#include "link.h"

#define DBG_PIN NRF_GPIO_PIN_MAP(0, CONFIG_APP_DEBUG_PIN)

/* TIMER4 as a free-running 1 MHz microsecond counter for latency stats.
 * ESB itself uses TIMER2. CC[0] is read from threads, CC[1] from the ESB
 * event ISR, so the two contexts never fight over one capture register. */
#define US_TIMER NRF_TIMER4

static const struct gpio_dt_spec led = GPIO_DT_SPEC_GET(DT_ALIAS(led0), gpios);

void led_toggle(void)
{
	gpio_pin_toggle_dt(&led);
}

void led_set(bool on)
{
	gpio_pin_set_dt(&led, on);
}

void dbg_pin_set(bool on)
{
	if (on) {
		nrf_gpio_pin_set(DBG_PIN);
	} else {
		nrf_gpio_pin_clear(DBG_PIN);
	}
}

/* The 1 MHz timer is only for radio round-trip stats; a running TIMER keeps
 * the 16 MHz clock requested, so battery builds leave it off. */
#define RTT_TIMER_ON IS_ENABLED(CONFIG_APP_RTT_STATS)

uint32_t us_now(void)
{
	if (!RTT_TIMER_ON) {
		return 0;
	}
	US_TIMER->TASKS_CAPTURE[0] = 1;
	return US_TIMER->CC[0];
}

uint32_t us_now_isr(void)
{
	if (!RTT_TIMER_ON) {
		return 0;
	}
	US_TIMER->TASKS_CAPTURE[1] = 1;
	return US_TIMER->CC[1];
}

static void us_timer_init(void)
{
	US_TIMER->TASKS_STOP = 1;
	US_TIMER->MODE = TIMER_MODE_MODE_Timer;
	US_TIMER->BITMODE = TIMER_BITMODE_BITMODE_32Bit;
	US_TIMER->PRESCALER = 4; /* 16 MHz / 2^4 = 1 MHz */
	US_TIMER->TASKS_CLEAR = 1;
	US_TIMER->TASKS_START = 1;
}

/*
 * Crash handler. USB is dead once this runs, so the serial port vanishes;
 * the LED says what happened instead: N fast blinks, a pause, repeat.
 *   1 blink  = CPU exception (bad pointer, bus fault, ...)
 *   2 blinks = spurious interrupt
 *   3 blinks = stack overflow
 *   4 blinks = kernel oops,  5 blinks = kernel panic
 * Replug USB to recover. (A quick replug can count as a double-tap reset
 * and land in the bootloader; just replug again.)
 */
void k_sys_fatal_error_handler(unsigned int reason, const struct arch_esf *esf)
{
	ARG_UNUSED(esf);
	const uint32_t pin = NRF_GPIO_PIN_MAP(0, DT_GPIO_PIN(DT_ALIAS(led0), gpios));
	unsigned int blinks = MIN(reason, 4U) + 1;

	(void)irq_lock();
	nrf_gpio_cfg_output(pin);
	for (;;) {
		for (unsigned int i = 0; i < blinks; i++) {
			nrf_gpio_pin_set(pin);
			k_busy_wait(120000);
			nrf_gpio_pin_clear(pin);
			k_busy_wait(180000);
		}
		k_busy_wait(900000);
	}
}

int main(void)
{
	int err;

	gpio_pin_configure_dt(&led, GPIO_OUTPUT_INACTIVE);
	nrf_gpio_cfg_output(DBG_PIN);
	dbg_pin_set(false);
	if (RTT_TIMER_ON) {
		us_timer_init();
	}

	err = radio_init(IS_ENABLED(CONFIG_APP_ROLE_PRX));
	if (err) {
		/* Fast blink forever = radio init failed. */
		while (1) {
			printk("ESB init failed: %d\n", err);
			led_toggle();
			k_msleep(100);
		}
	}

	printk("ESB link test: %s, ch %d, retx %d x %d us\n",
	       IS_ENABLED(CONFIG_APP_ROLE_PRX) ? "PRX (console side)" : "PTX (controller side)",
	       CONFIG_APP_RF_CHANNEL, CONFIG_APP_RETRANSMIT_COUNT,
	       CONFIG_APP_RETRANSMIT_DELAY_US);

	role_run();
	return 0;
}
```

## src/gc_logic.c
```c
/* Pure decision logic, see gc_logic.h. No hardware, no kernel calls. */
#include <stdlib.h>
#include "gc_logic.h"

#define BYTE0_BUTTONS (START_BTN | Y_BTN | X_BTN | B_BTN | A_BTN)
#define BYTE1_BUTTONS (L_BTN | R_BTN | Z_BTN | D_UP_BTN | D_DOWN_BTN | \
		       D_RIGHT_BTN | D_LEFT_BTN)

#define OTA_BYTE0_MASK (A_BTN)
#define OTA_BYTE1_MASK (L_BTN | R_BTN | Z_BTN)

/* ------------------------------------------------------------------ */
/* Input comparison                                                    */
/* ------------------------------------------------------------------ */

bool gc_analog_moved(const GC_Payload *a, const GC_Payload *b, int thresh)
{
	const uint8_t *pa = &a->joy_X_val;
	const uint8_t *pb = &b->joy_X_val;

	for (int i = 0; i < 6; i++) {
		if (abs((int)pa[i] - (int)pb[i]) >= thresh) {
			return true;
		}
	}
	return false;
}

bool gc_buttons_changed(const GC_Payload *a, const GC_Payload *b)
{
	return ((a->byte0 ^ b->byte0) & BYTE0_BUTTONS) ||
	       ((a->byte1 ^ b->byte1) & BYTE1_BUTTONS);
}

bool gc_input_changed(const GC_Payload *a, const GC_Payload *b, int thresh)
{
	return a->byte0 != b->byte0 || a->byte1 != b->byte1 ||
	       gc_analog_moved(a, b, thresh);
}

GC_Payload gc_neutral_input(const GC_Origin *origin)
{
	GC_Payload n = origin->state;

	n.byte0 = 0;
	n.byte1 = GC_BYTE1_ALWAYS_ONE;
	return n;
}

/* ------------------------------------------------------------------ */
/* Adaptive poll rate                                                  */
/* ------------------------------------------------------------------ */

void gc_rate_init(struct gc_rate *r, const GC_Payload *ref, int64_t now)
{
	r->ref = *ref;
	r->last_change = now;
	r->fast = true;
}

bool gc_rate_update(struct gc_rate *r, const GC_Payload *pad, int64_t now,
		    int thresh, int64_t hold_ms)
{
	if (gc_input_changed(pad, &r->ref, thresh)) {
		r->ref = *pad;
		r->last_change = now;
		if (!r->fast) {
			r->fast = true;
			return true;
		}
	} else if (r->fast && now - r->last_change >= hold_ms) {
		r->fast = false;
		return true;
	}
	return false;
}

/* ------------------------------------------------------------------ */
/* Link state                                                          */
/* ------------------------------------------------------------------ */

void gc_link_init(struct gc_link *l, int64_t now)
{
	l->up = true;
	l->last_ack = now;
	l->lost_at = 0;
	l->last_probe = 0;
}

bool gc_link_want_send(const struct gc_link *l, int64_t now, bool changed,
		       bool rumble, int64_t last_send, int64_t keepalive_ms,
		       int64_t probe_ms)
{
	if (l->up) {
		return changed || rumble || now - last_send >= keepalive_ms;
	}
	return now - l->last_probe >= probe_ms;
}

enum gc_link_event gc_link_on_send(struct gc_link *l, int64_t now, bool acked,
				   int64_t loss_ms)
{
	l->last_probe = now;

	if (acked) {
		l->last_ack = now;
		if (!l->up) {
			l->up = true;
			return GC_LINK_RESTORED;
		}
	} else if (l->up && now - l->last_ack >= loss_ms) {
		l->up = false;
		l->lost_at = now;
		return GC_LINK_LOST;
	}
	return GC_LINK_NONE;
}

/* ------------------------------------------------------------------ */
/* Sequence filter                                                     */
/* ------------------------------------------------------------------ */

void gc_seq_init(struct gc_seq *s)
{
	s->expected = 0;
	s->have = false;
	s->behind_run = 0;
}

enum gc_seq_result gc_seq_check(struct gc_seq *s, uint8_t seq, bool is_origin,
				uint32_t *missed)
{
	/* Distance ahead of what we expect, modulo 256. 128..255 = behind. */
	uint8_t gap = (uint8_t)(seq - s->expected);
	bool behind = s->have && gap >= 128;

	*missed = 0;
	if (behind && !is_origin && ++s->behind_run < GC_SEQ_BEHIND_RESYNC) {
		return GC_SEQ_DUP;
	}
	if (s->have && !behind) {
		*missed = gap;
	}
	s->behind_run = 0;
	s->expected = (uint8_t)(seq + 1);
	s->have = true;
	return GC_SEQ_ACCEPT;
}

/* ------------------------------------------------------------------ */
/* OTA combo                                                           */
/* ------------------------------------------------------------------ */

bool gc_ota_combo_pressed(const GC_Payload *pad)
{
	return (pad->byte0 & OTA_BYTE0_MASK) == OTA_BYTE0_MASK &&
	       (pad->byte1 & OTA_BYTE1_MASK) == OTA_BYTE1_MASK;
}

int64_t gc_combo_hold(int64_t *since, bool pressed, int64_t now)
{
	if (!pressed) {
		*since = -1;
		return -1;
	}
	if (*since < 0) {
		*since = now;
	}
	return now - *since;
}
```

## src/gc_logic.h
```c
/*
 * Pure decision logic shared by the controller (ptx.c) and receiver (prx.c).
 *
 * Nothing in here touches hardware, Zephyr kernel objects or the clock:
 * callers pass in "now" and the current input, and get back a decision.
 * That keeps it unit-testable on a PC (tests/unit, native_sim).
 */
#pragma once

#include <stdbool.h>
#include <stdint.h>
#include "gc_protocol.h"

#ifdef __cplusplus
extern "C" {
#endif

/* ------------------------------------------------------------------ */
/* Input comparison                                                    */
/* ------------------------------------------------------------------ */

/* Any analog value (sticks, triggers) differs by at least `thresh`. */
bool gc_analog_moved(const GC_Payload *a, const GC_Payload *b, int thresh);

/* Any real button differs (status bits like ALWAYS_ONE are ignored). */
bool gc_buttons_changed(const GC_Payload *a, const GC_Payload *b);

/* Raw button/status bytes differ, or analog moved by at least `thresh`. */
bool gc_input_changed(const GC_Payload *a, const GC_Payload *b, int thresh);

/* Neutral input for a given origin: origin sticks/triggers, no buttons. */
GC_Payload gc_neutral_input(const GC_Origin *origin);

/* ------------------------------------------------------------------ */
/* Adaptive poll rate (controller)                                     */
/* ------------------------------------------------------------------ */

struct gc_rate {
	GC_Payload ref;        /* input at the last real change */
	int64_t last_change;   /* ms */
	bool fast;
};

/* Start fast, with `ref` as the resting reference. */
void gc_rate_init(struct gc_rate *r, const GC_Payload *ref, int64_t now);

/* Feed one poll. A change of at least `thresh` from the reference (not from
 * the previous poll, so noise around a resting value never counts) goes
 * fast; `hold_ms` without one goes slow. Returns true if `fast` changed. */
bool gc_rate_update(struct gc_rate *r, const GC_Payload *pad, int64_t now,
		    int thresh, int64_t hold_ms);

/* ------------------------------------------------------------------ */
/* Link state (controller)                                             */
/* ------------------------------------------------------------------ */

struct gc_link {
	bool up;
	int64_t last_ack;      /* ms of the last acknowledged packet */
	int64_t lost_at;       /* ms the link was declared lost */
	int64_t last_probe;    /* ms of the last send while lost */
};

enum gc_link_event {
	GC_LINK_NONE,
	GC_LINK_LOST,          /* just declared lost */
	GC_LINK_RESTORED,      /* first ACK after being lost */
};

/* Starts "up", as if acknowledged at `now`. */
void gc_link_init(struct gc_link *l, int64_t now);

/* Should we send this tick? Linked: on change, rumble, or keepalive due.
 * Lost: only a probe every `probe_ms`. */
bool gc_link_want_send(const struct gc_link *l, int64_t now, bool changed,
		       bool rumble, int64_t last_send, int64_t keepalive_ms,
		       int64_t probe_ms);

/* Record the result of a send. Lost after `loss_ms` with no ACK at all. */
enum gc_link_event gc_link_on_send(struct gc_link *l, int64_t now, bool acked,
				   int64_t loss_ms);

/* ------------------------------------------------------------------ */
/* Sequence filter (receiver)                                          */
/* ------------------------------------------------------------------ */

/* Packets this far behind in a row -> assume the controller restarted. */
#define GC_SEQ_BEHIND_RESYNC 8

struct gc_seq {
	uint8_t expected;
	bool have;
	uint8_t behind_run;    /* consecutive packets behind `expected` */
};

enum gc_seq_result {
	GC_SEQ_ACCEPT,
	GC_SEQ_DUP,            /* behind expected: duplicate or out of order */
};

void gc_seq_init(struct gc_seq *s);

/* Classify one received packet. On ACCEPT, *missed gets the number of
 * sequence numbers skipped (packets the controller gave up on); on DUP it
 * is set to 0. Origin packets always resync, because the controller sends
 * one first after every (re)start, when its count starts over. */
enum gc_seq_result gc_seq_check(struct gc_seq *s, uint8_t seq, bool is_origin,
				uint32_t *missed);

/* ------------------------------------------------------------------ */
/* OTA combo (controller): L + R + Z + A                               */
/* ------------------------------------------------------------------ */

bool gc_ota_combo_pressed(const GC_Payload *pad);

/* Track how long the combo has been held. `*since` is -1 when not held.
 * Returns the hold time in ms, or -1 if the combo isn't held right now. */
int64_t gc_combo_hold(int64_t *since, bool pressed, int64_t now);

#ifdef __cplusplus
}
#endif
```

## src/joybus.c
```c
/**
 * joybus.c - bit-banged Joybus host for nRF52840 (controller board).
 *
 * Same approach as the ESP32 version: busy-wait on a cycle counter with
 * interrupts masked, so every edge lands where it should. The counter only
 * runs while the CPU runs, which is fine because we never sleep mid-transfer.
 *
 * Pin handling: open drain. OUTCLR pulls the line low, OUTSET releases it to
 * the pull-up, and IN still reads the real line level so we can see the pad.
 */
#include <errno.h>
#include "joybus.h"
#include "joybus_priv.h"

#define HOST_REPLY_TIMEOUT_US  100    /* wait for the pad to start replying */
#define HOST_STOP_LOW_US       1      /* console-style stop bit */

/* ------------------------------------------------------------------ */
/* Bit-level TX / RX                                                   */
/* ------------------------------------------------------------------ */

static void send_bytes(const uint8_t *buf, int n, uint32_t stop_low_us)
{
	const uint32_t us = jb_cc_us;
	uint32_t t = jb_now();

	for (int i = 0; i < n; i++) {
		uint8_t v = buf[i];

		for (int b = 0; b < 8; b++, v <<= 1) {
			uint32_t low = (v & 0x80) ? us : 3 * us;

			JB_LINE_LOW();
			t += low;
			jb_wait_until(t);
			JB_LINE_REL();
			t += 4 * us - low;
			jb_wait_until(t);
		}
	}
	/* stop bit */
	JB_LINE_LOW();
	t += stop_low_us * us;
	jb_wait_until(t);
	JB_LINE_REL();
}

/**
 * Read n bytes, MSB first.
 * Returns n on success, -1 if the very first bit never started (idle),
 * -2 if it timed out partway through (a real error).
 */
static int read_bytes(uint8_t *buf, int n, uint32_t first_timeout_us)
{
	for (int i = 0; i < n; i++) {
		uint8_t v = 0;

		for (int b = 0; b < 8; b++) {
			bool first = (i == 0 && b == 0);
			int bit = jb_read_bit((first ? first_timeout_us : JB_BIT_TIMEOUT_US) *
					      jb_cc_us);

			if (bit < 0) {
				return first ? -1 : -2;
			}
			v = (uint8_t)((v << 1) | bit);
		}
		buf[i] = v;
	}
	return n;
}

/* ------------------------------------------------------------------ */
/* Host mode                                                           */
/* ------------------------------------------------------------------ */

int joybus_host_init(uint8_t p0_pin)
{
	return jb_pin_init(p0_pin);
}

static int host_xfer(const uint8_t *cmd, int cmd_len, uint8_t *reply, int reply_len)
{
	uint32_t key = jb_crit_enter();

	send_bytes(cmd, cmd_len, HOST_STOP_LOW_US);
	int n = read_bytes(reply, reply_len, HOST_REPLY_TIMEOUT_US);

	jb_crit_exit(key);
	return (n == reply_len) ? 0 : -ETIMEDOUT;
}

int joybus_host_read_id(uint8_t id[3])
{
	const uint8_t cmd = GC_CMD_ID;

	return host_xfer(&cmd, 1, id, 3);
}

int joybus_host_read_origin(GC_Origin *out)
{
	const uint8_t cmd = GC_CMD_ORIGIN;

	return host_xfer(&cmd, 1, (uint8_t *)out, sizeof(GC_Origin));
}

int joybus_host_poll(uint32_t cmd24, GC_Payload *out)
{
	const uint8_t cmd[3] = {
		(uint8_t)(cmd24 >> 16), (uint8_t)(cmd24 >> 8), (uint8_t)cmd24
	};

	return host_xfer(cmd, 3, (uint8_t *)out, sizeof(GC_Payload));
}
```

## src/joybus.h
```c
#pragma once
/**
 * joybus.h - Joybus bit layer for nRF52840 (bit-banged, cycle-counted).
 * Port of the ESP32 version in Wireless-Gamecube-Controller.
 *
 * Electrical: one open-drain data line, idle high.
 *   Controller board: needs an external 1k pull-up to 3.3V.
 *   Receiver board:   the console provides the pull-up.
 *
 * Timing: 4 us per bit. A 1 is 1 us low + 3 us high; a 0 is 3 us low + 1 us high.
 *   Console stop bit = 1 us low, controller stop bit = 2 us low.
 *
 * Transfers run with all interrupts masked (PRIMASK) (~100 us for the command plus up to
 * ~330 us for the reply). Call them from thread context, and not while an ESB
 * transmission is in flight: the controller loop polls the pad first and only
 * then hands the result to the radio, so the two never overlap.
 *
 * The data pin must be on port 0 (P0.00 - P0.31).
 */
#include <stdbool.h>
#include <stdint.h>
#include "gc_protocol.h"

/* ---------- Host mode (controller board: nRF52 talks to the real pad) ---------- */

/* All return 0 on success, -ETIMEDOUT if the pad didn't answer completely. */
int joybus_host_init(uint8_t p0_pin);
int joybus_host_read_id(uint8_t id[3]);                 // 0x00 -> 3 bytes
int joybus_host_read_origin(GC_Origin *out);            // 0x41 -> 10 bytes
int joybus_host_poll(uint32_t cmd24, GC_Payload *out);  // 0x40.. -> 8 bytes

/* ---------- Target mode (receiver board: nRF52 pretends to be the pad) ---------- */
/*
 * See joybus_target.c for how this works. In short: the command is received
 * in a zero-latency ISR (interrupts held off ~100 us max), and the reply is
 * played by PWM1 + EasyDMA so the CPU and radio stay free.
 * Uses: PWM1, TIMER3, EGU5/SWI5, one PPI channel, one GPIOTE channel.
 */

struct joybus_target_stats {
	uint32_t polls;     /* 0x40 answered */
	uint32_t origins;   /* 0x41 / 0x42 answered */
	uint32_t ids;       /* 0x00 / 0xFF answered */
	uint32_t errors;    /* edge timeout mid-command */
	uint32_t unknown;   /* unsupported command byte */
	uint32_t late;      /* ISR started too late to read the first bit */
};

int joybus_target_init(uint8_t p0_pin);

/** Re-encode the poll and origin replies. Safe from thread or ISR context
 *  (not from a zero-latency ISR). */
void joybus_target_set_state(const GC_Payload *in, const GC_Origin *origin);

/** Rumble bit from the console's most recent poll. */
uint8_t joybus_target_rumble(void);

void joybus_target_get_stats(struct joybus_target_stats *out, bool reset);
```

## src/joybus_priv.h
```c
#pragma once
/**
 * joybus_priv.h - bit-timing helpers shared by joybus.c (host) and
 * joybus_target.c (target). Each .c file that includes this gets its own
 * copy of jb_mask / jb_cc_us and must call jb_pin_init().
 *
 * Timing base is the Cortex-M4 DWT cycle counter (64 MHz on nRF52840).
 */
#include <stdbool.h>
#include <stdint.h>
#include <zephyr/kernel.h>
#include <hal/nrf_gpio.h>
#include <nrfx.h>

#define JB_BIT_TIMEOUT_US  10     /* max time for one bit's edges */

static uint32_t jb_mask;     /* bit mask within NRF_P0 */
static uint32_t jb_cc_us;    /* CPU cycles per microsecond */

#define JB_LINE_LOW()   (NRF_P0->OUTCLR = jb_mask)
#define JB_LINE_REL()   (NRF_P0->OUTSET = jb_mask)
#define JB_LINE_HIGH()  ((NRF_P0->IN & jb_mask) != 0)

static ALWAYS_INLINE uint32_t jb_now(void)
{
	return DWT->CYCCNT;
}

static ALWAYS_INLINE void jb_wait_until(uint32_t t)
{
	while ((int32_t)(jb_now() - t) < 0) {
	}
}

/* Wait for the line to reach `high`. False if `timeout_cc` passes since `start`. */
static ALWAYS_INLINE bool jb_wait_level(bool high, uint32_t start, uint32_t timeout_cc)
{
	while (JB_LINE_HIGH() != high) {
		if ((uint32_t)(jb_now() - start) > timeout_cc) {
			return false;
		}
	}
	return true;
}

/* Wait for the end of the current low, then the next falling edge, and
 * sample 2 us later. Returns 0/1, or -1 on timeout. */
static ALWAYS_INLINE int jb_read_bit(uint32_t timeout_cc)
{
	uint32_t start = jb_now();

	if (!jb_wait_level(true, start, timeout_cc)) {
		return -1;
	}
	if (!jb_wait_level(false, start, timeout_cc)) {
		return -1;
	}
	jb_wait_until(jb_now() + 2 * jb_cc_us);
	return JB_LINE_HIGH() ? 1 : 0;
}

/* Mask *all* interrupts, including Zephyr zero-latency IRQs that irq_lock()
 * leaves enabled. */
static ALWAYS_INLINE uint32_t jb_crit_enter(void)
{
	uint32_t primask = __get_PRIMASK();

	__disable_irq();
	return primask;
}

static ALWAYS_INLINE void jb_crit_exit(uint32_t primask)
{
	__set_PRIMASK(primask);
}

/* Start the DWT cycle counter and set the pin to open drain, released. */
static inline int jb_pin_init(uint8_t p0_pin)
{
	if (p0_pin > 31) {
		return -EINVAL;
	}
	jb_mask = BIT(p0_pin);
	jb_cc_us = SystemCoreClock / 1000000U;   /* 64 on nRF52840 */

	CoreDebug->DEMCR |= CoreDebug_DEMCR_TRCENA_Msk;
	DWT->CTRL |= DWT_CTRL_CYCCNTENA_Msk;

	/* Release first so the line doesn't glitch low while we switch modes. */
	NRF_P0->OUTSET = jb_mask;
	nrf_gpio_cfg(NRF_GPIO_PIN_MAP(0, p0_pin),
		     NRF_GPIO_PIN_DIR_OUTPUT,
		     NRF_GPIO_PIN_INPUT_CONNECT,
		     NRF_GPIO_PIN_PULLUP,        /* weak; real pull-up is external/console */
		     NRF_GPIO_PIN_S0D1,          /* open drain */
		     NRF_GPIO_PIN_NOSENSE);
	return 0;
}
```

## src/joybus_target.c
```c
/**
 * joybus_target.c - Joybus target for nRF52840 (receiver board pretends to
 * be the controller).
 *
 * Why this differs from the ESP32 version
 * ---------------------------------------
 * On the ESP32, a whole core busy-polls the line with interrupts off. Here we
 * have one core, and ESB has a hard interrupt deadline: when a packet arrives,
 * its radio ISR must set up the ACK before the radio finishes turning around
 * (130 us with normal ramp-up). So the CPU may only be held for well under
 * 130 us at a time. The work is split:
 *
 *   1. Detect:  a GPIOTE channel in event mode fires IN[n] on the command's
 *               first falling edge. PPI routes it, with no CPU involved, to
 *               - TIMER3 CAPTURE[0], and disables its own channel, so CC[0]
 *                 keeps the FIRST edge even if the ISR starts a little late
 *               - EGU5 TRIGGER[0], which raises our zero-latency ISR
 *   2. Receive: the ISR (running from RAM) measures each low pulse of the
 *               command and its stop bit, with interrupts masked (~121 us
 *               for a 3-byte poll at the console's 5 us bit time).
 *   3. Reply:   PWM1 plays a pre-encoded reply out of RAM via EasyDMA, one PWM
 *               period (4 us) per Joybus bit. The ISR just starts it and
 *               returns, so the radio is free during the ~270 us reply.
 *   4. Re-arm:  when the PWM stops, its ISR turns the GPIOTE event back on.
 *
 * The GPIOTE channel is only in event mode while waiting for a command, and
 * is switched off before the PWM drives the pin, so the two peripherals never
 * own the pin at the same time.
 *
 * Lessons from bring-up, so they don't get undone:
 *   - GPIO SENSE/PORT is a low-power wake-up path and fired ~10 us late.
 *     GPIOTE IN events are synchronized to 16 MHz and fire on time.
 *   - From flash, this ISR's code is usually out of the instruction cache
 *     (it runs every few ms) and the misses cost ~1.7 us. It runs from RAM.
 *   - Waking from WFI delays the ISR; the receiver keeps the CPU awake
 *     (CONFIG_GC_RX_NO_SLEEP) and in constant-latency mode.
 *   - The console's bits are 5 us long and the line rings. Bits are decoded
 *     by low-pulse WIDTH, and the edge loop does nothing but read the pin and
 *     the cycle counter: extra work between bits (~1.5 us at one point) made
 *     every next edge be seen late and dropped short 1 bits.
 *
 * Reply buffers are encoded ahead of time by joybus_target_set_state()
 * (called from the ESB ISR on every new input), triple-buffered so the
 * buffer the PWM is reading is never rewritten.
 *
 * Electrical: the console provides the pull-up. The pin is open drain;
 * the PWM output goes through the pin's S0D1 drive setting, so a PWM "high"
 * just releases the line.
 */
#include <errno.h>
#include <string.h>
#include <zephyr/kernel.h>
#include <zephyr/irq.h>
#include <helpers/nrfx_gppi.h>
#include <nrfx_gpiote.h>
#include <zephyr/drivers/gpio/gpio_nrf.h>
#include "joybus.h"
#include "joybus_priv.h"

/* Bit decoding: a console 1 is low ~1.1-1.6 us, a 0 is low ~3.1-4.2 us.
 * Pulses shorter than GLITCH are ringing and are ignored. If the ISR starts
 * after the first bit's low has already ended (line high on entry), that bit
 * must have been a 1 - as long as we got here before FIRST_LATEST, when even
 * a 0 could have ended. */
#define CC_PER_US          64U                      /* nRF52840: 64 MHz */
#define BIT_THRESH_CC      (23U * CC_PER_US / 10U)  /* < 2.3 us low = 1 */
#define GLITCH_CC          (25U * CC_PER_US / 100U) /* < 0.25 us = ringing */
#define FIRST_LATEST_CC    (29U * CC_PER_US / 10U)
#define LOW_TIMEOUT_CC     (8U * CC_PER_US)         /* max wait for an edge */
#define REPLY_DELAY_CC     (2U * CC_PER_US)         /* stop bit -> reply */

BUILD_ASSERT(CC_PER_US == 64U, "nRF52840 core clock is 64 MHz");

/* PWM: 16 MHz, 64 ticks = 4 us per Joybus bit. With bit 15 clear, each
 * value means "low for N ticks, then high" (Zephyr pwm_nrfx: inverted). */
#define PWM_TOP            64
#define PWM_ONE            16     /* 1 us low, 3 us high */
#define PWM_ZERO           48     /* 3 us low, 1 us high */
#define PWM_STOP           32     /* controller stop bit: 2 us low */
#define PWM_IDLE           0      /* high for the whole period */

#define VALS(nbytes)       ((nbytes) * 8 + 2)   /* bits + stop + idle */

#define JB_PWM             NRF_PWM1
#define JB_PWM_IRQn        PWM1_IRQn
#define JB_EGU             NRF_EGU5
#define JB_EGU_IRQn        SWI5_EGU5_IRQn
#define JB_TIMER           NRF_TIMER3

/* ------------------------------------------------------------------ */
/* State                                                               */
/* ------------------------------------------------------------------ */

struct reply_set {
	uint16_t poll[VALS(sizeof(GC_Payload))];
	uint16_t origin[VALS(sizeof(GC_Origin))];
};

static struct reply_set s_sets[3];
static uint16_t s_id_reply[VALS(3)];
static volatile uint8_t s_pub;           /* newest complete set */
static volatile uint8_t s_play = 0xFF;   /* set the PWM is reading, or 0xFF */

static volatile uint8_t s_rumble;
static volatile bool s_rearm_pending;
static uint8_t s_pin;
static uint8_t s_gpiote_ch;
static nrfx_gppi_group_handle_t s_grp;   /* holds the timestamp channel */

static struct joybus_target_stats s_stats;

/* ------------------------------------------------------------------ */
/* Reply buffers                                                       */
/* ------------------------------------------------------------------ */

static void encode(uint16_t *dst, const uint8_t *src, int n)
{
	for (int i = 0; i < n; i++) {
		uint8_t v = src[i];

		for (int b = 0; b < 8; b++, v <<= 1) {
			*dst++ = (v & 0x80) ? PWM_ONE : PWM_ZERO;
		}
	}
	*dst++ = PWM_STOP;
	*dst = PWM_IDLE;
}

void joybus_target_set_state(const GC_Payload *in, const GC_Origin *origin)
{
	/* irq_lock keeps two kernel-level writers apart; it does not block the
	 * zero-latency ISR, which is fine: we never write the set it may pick
	 * (s_pub) or the one the PWM is playing (s_play). */
	unsigned int key = irq_lock();
	uint8_t pub = s_pub;
	uint8_t play = s_play;
	uint8_t idx = 0;

	while (idx == pub || idx == play) {
		idx++;
	}
	encode(s_sets[idx].poll, (const uint8_t *)in, sizeof(*in));
	encode(s_sets[idx].origin, (const uint8_t *)origin, sizeof(*origin));
	__DMB();
	s_pub = idx;
	irq_unlock(key);
}

uint8_t joybus_target_rumble(void)
{
	return s_rumble;
}

void joybus_target_get_stats(struct joybus_target_stats *out, bool reset)
{
	*out = s_stats;
	if (reset) {
		memset(&s_stats, 0, sizeof(s_stats));
	}
}

/* ------------------------------------------------------------------ */
/* Arm / disarm the start-of-command trigger                           */
/* ------------------------------------------------------------------ */

static ALWAYS_INLINE void disarm(void)
{
	NRF_GPIOTE->CONFIG[s_gpiote_ch] = GPIOTE_CONFIG_MODE_Disabled << GPIOTE_CONFIG_MODE_Pos;
	NRF_GPIOTE->EVENTS_IN[s_gpiote_ch] = 0;
}

/* Arm only while the line is idle high; otherwise the 1 ms service timer
 * retries. Never called from the zero-latency ISR. */
static void rearm(void)
{
	unsigned int key = irq_lock();

	if (JB_LINE_HIGH()) {
		/* Re-enable the timestamp channel; the first falling edge of the
		 * next command disables it again, so CC[0] keeps that edge. */
		nrfx_gppi_group_enable(s_grp);
		NRF_GPIOTE->EVENTS_IN[s_gpiote_ch] = 0;
		NRF_GPIOTE->CONFIG[s_gpiote_ch] =
			(GPIOTE_CONFIG_MODE_Event << GPIOTE_CONFIG_MODE_Pos) |
			((uint32_t)s_pin << GPIOTE_CONFIG_PSEL_Pos) |
			(0UL << GPIOTE_CONFIG_PORT_Pos) |
			(GPIOTE_CONFIG_POLARITY_HiToLo << GPIOTE_CONFIG_POLARITY_Pos);
		s_rearm_pending = false;
	} else {
		s_rearm_pending = true;
	}
	irq_unlock(key);
}

static void service_fn(struct k_timer *t)
{
	ARG_UNUSED(t);
	if (s_rearm_pending && s_play == 0xFF) {
		rearm();
	}
}
static K_TIMER_DEFINE(service_timer, service_fn, NULL);

/* ------------------------------------------------------------------ */
/* Command receive (zero-latency ISR, runs from RAM)                   */
/* ------------------------------------------------------------------ */

/* Lean edge wait: a pin read, a cycle-counter read and a compare. */
static ALWAYS_INLINE bool wait_lvl(bool high, uint32_t start)
{
	while (JB_LINE_HIGH() != high) {
		if ((uint32_t)(DWT->CYCCNT - start) > LOW_TIMEOUT_CC) {
			return false;
		}
	}
	return true;
}

/* Measure the next real low pulse: width in cycles (0 on timeout) and the
 * time of its rise. A short low after a rise (ringing) is skipped; a short
 * high inside a low just restarts the fall time a little later. */
static ALWAYS_INLINE uint32_t next_low(uint32_t *t_rise)
{
	uint32_t start = DWT->CYCCNT;

	for (;;) {
		if (!wait_lvl(false, start)) {
			return 0;
		}
		uint32_t tf = DWT->CYCCNT;

		if (!wait_lvl(true, tf)) {
			return 0;
		}
		uint32_t tr = DWT->CYCCNT;
		uint32_t w = tr - tf;

		if (w >= GLITCH_CC) {
			*t_rise = tr;
			return w;
		}
	}
}

static ALWAYS_INLINE int cmd_length(uint8_t c)
{
	if (c == GC_CMD_ID || c == GC_CMD_ORIGIN || c == GC_CMD_RESET) {
		return 1;
	}
	if (c == GC_CMD_POLL || c == GC_CMD_RECALIBRATE) {
		return 3;
	}
	return -1;
}

static ALWAYS_INLINE void start_reply(uint16_t *vals, uint16_t count)
{
	JB_PWM->EVENTS_STOPPED = 0;
	JB_PWM->EVENTS_SEQEND[0] = 0;
	JB_PWM->SEQ[0].PTR = (uint32_t)vals;
	JB_PWM->SEQ[0].CNT = count;
	JB_PWM->TASKS_SEQSTART[0] = 1;
}

/*
 * A plain void function works as a direct, zero-latency ISR (no kernel calls,
 * no rescheduling). Every helper it uses is ALWAYS_INLINE, so it all lives in
 * RAM with it.
 */
static __ramfunc void jb_target_isr(void)
{
	uint32_t key = jb_crit_enter();
	uint8_t cmd[3];
	uint32_t tr;
	int len;

	JB_EGU->EVENTS_TRIGGERED[0] = 0;
	disarm();

	/* Where was the first falling edge, in CPU cycles? TIMER3 runs at
	 * 16 MHz (4 CPU cycles per tick) and captured it in CC[0] via PPI. */
	JB_TIMER->TASKS_CAPTURE[1] = 1;
	uint32_t ago_cc = (JB_TIMER->CC[1] - JB_TIMER->CC[0]) * 4;
	uint32_t t0 = DWT->CYCCNT - ago_cc;

	/* First bit, before anything else. If the line is still low, time the
	 * low from the captured edge; if it's already high, it was a short
	 * low, i.e. a 1 (only valid if we're not too late). */
	uint8_t v;

	if (JB_LINE_HIGH()) {
		if (ago_cc > FIRST_LATEST_CC) {
			s_stats.late++;
			goto fail;
		}
		v = 1;
	} else {
		if (!wait_lvl(true, t0)) {
			s_stats.errors++;
			goto fail;
		}
		v = ((DWT->CYCCNT - t0) < BIT_THRESH_CC);
	}

	for (int b = 1; b < 8; b++) {
		uint32_t w = next_low(&tr);

		if (w == 0) {
			s_stats.errors++;
			goto fail;
		}
		v = (uint8_t)((v << 1) | (w < BIT_THRESH_CC));
	}
	cmd[0] = v;

	len = cmd_length(cmd[0]);
	if (len < 0) {
		s_stats.unknown++;
		goto fail;
	}
	for (int i = 1; i < len; i++) {
		v = 0;
		for (int b = 0; b < 8; b++) {
			uint32_t w = next_low(&tr);

			if (w == 0) {
				s_stats.errors++;
				goto fail;
			}
			v = (uint8_t)((v << 1) | (w < BIT_THRESH_CC));
		}
		cmd[i] = v;
	}

	/* Console stop bit: one more short low, then the line goes idle. If no
	 * stop low shows up but the line is idle high, the command bits were
	 * all good, so reply anyway. */
	uint32_t t_stop;
	uint32_t sstart = DWT->CYCCNT;

	if (!wait_lvl(false, sstart)) {
		if (!JB_LINE_HIGH()) {
			s_stats.errors++;
			goto fail;
		}
		t_stop = DWT->CYCCNT;
	} else {
		uint32_t tf = DWT->CYCCNT;

		if (!wait_lvl(true, tf)) {
			s_stats.errors++;
			goto fail;
		}
		t_stop = DWT->CYCCNT;
	}

	/* Pick the reply. */
	uint16_t *vals;
	uint16_t count;
	uint8_t set = s_pub;

	switch (cmd[0]) {
	case GC_CMD_POLL:
		vals = s_sets[set].poll;
		count = ARRAY_SIZE(s_sets[set].poll);
		s_rumble = cmd[2] & GC_RUMBLE_BIT;
		s_stats.polls++;
		break;
	case GC_CMD_ORIGIN:
	case GC_CMD_RECALIBRATE:
		vals = s_sets[set].origin;
		count = ARRAY_SIZE(s_sets[set].origin);
		s_stats.origins++;
		break;
	default: /* GC_CMD_ID, GC_CMD_RESET */
		vals = s_id_reply;
		count = ARRAY_SIZE(s_id_reply);
		s_stats.ids++;
		break;
	}
	s_play = set;

	jb_wait_until(t_stop + REPLY_DELAY_CC);
	start_reply(vals, count);
	/* PWM1's STOPPED interrupt re-arms once the reply is out. */
	jb_crit_exit(key);
	return;

fail:
	/* Garbage or a command we don't know: no reply. The service timer
	 * re-arms once the line is idle. */
	s_rearm_pending = true;
	jb_crit_exit(key);
}

static void pwm_isr(const void *arg)
{
	ARG_UNUSED(arg);
	if (JB_PWM->EVENTS_STOPPED) {
		JB_PWM->EVENTS_STOPPED = 0;
		s_play = 0xFF;
		rearm();
	}
}

/* ------------------------------------------------------------------ */
/* Init                                                                */
/* ------------------------------------------------------------------ */

int joybus_target_init(uint8_t p0_pin)
{
	static const uint8_t id[3] = { GC_ID_BYTE0, GC_ID_BYTE1, GC_ID_BYTE2 };
	const GC_Payload neutral = {
		.byte1 = GC_BYTE1_ALWAYS_ONE,
		.joy_X_val = 128, .joy_Y_val = 128,
		.C_stick_X_val = 128, .C_stick_Y_val = 128,
	};
	const GC_Origin neutral_origin = { .state = neutral };
	nrfx_gppi_handle_t ppi_ts, ppi_irq;
	int err;

	err = jb_pin_init(p0_pin);
	if (err) {
		return err;
	}
	s_pin = p0_pin;

	/* Constant-latency mode: keeps the CPU's clock and regulators ready
	 * while idle, so an interrupt starts quickly. Costs some idle current,
	 * which doesn't matter on the console-powered receiver. */
	NRF_POWER->TASKS_CONSTLAT = 1;

	/* Replies: ID is fixed; poll/origin start neutral until the
	 * controller board sends real data. */
	encode(s_id_reply, id, sizeof(id));
	joybus_target_set_state(&neutral, &neutral_origin);

	/* Borrow one GPIOTE channel from Zephyr's GPIO driver, so its own
	 * channel use can't collide with ours. Its interrupt stays off; the
	 * event only feeds PPI. */
	nrfx_gpiote_t *gpiote = gpio_nrf_gpiote_by_port_get(DEVICE_DT_GET(DT_NODELABEL(gpio0)));

	err = nrfx_gpiote_channel_alloc(gpiote, &s_gpiote_ch);
	if (err) {
		return err;
	}
	NRF_GPIOTE->INTENCLR = BIT(s_gpiote_ch);
	disarm();

	/* TIMER3: free-running 16 MHz timestamp counter. */
	JB_TIMER->TASKS_STOP = 1;
	JB_TIMER->MODE = TIMER_MODE_MODE_Timer;
	JB_TIMER->BITMODE = TIMER_BITMODE_BITMODE_32Bit;
	JB_TIMER->PRESCALER = 0;
	JB_TIMER->TASKS_CLEAR = 1;
	JB_TIMER->TASKS_START = 1;

	/* PPI, all hardware:
	 *   timestamp: IN -> TIMER3 CAPTURE[0], fork -> disable its own group
	 *   irq:       IN -> EGU5 TRIGGER[0] (raises the ISR) */
	uint32_t ev = (uint32_t)&NRF_GPIOTE->EVENTS_IN[s_gpiote_ch];

	err = nrfx_gppi_group_alloc(0, &s_grp);
	if (err) {
		return err;
	}
	err = nrfx_gppi_conn_alloc(ev, (uint32_t)&JB_TIMER->TASKS_CAPTURE[0], &ppi_ts);
	if (err) {
		return err;
	}
	err = nrfx_gppi_ep_attach(nrfx_gppi_group_task_dis_addr(s_grp), ppi_ts);
	if (err) {
		return err;
	}
	nrfx_gppi_group_ch_add(s_grp, ppi_ts);
	nrfx_gppi_conn_enable(ppi_ts);

	err = nrfx_gppi_conn_alloc(ev, (uint32_t)&JB_EGU->TASKS_TRIGGER[0], &ppi_irq);
	if (err) {
		return err;
	}
	nrfx_gppi_conn_enable(ppi_irq);

	/* EGU5 -> zero-latency ISR. */
	JB_EGU->EVENTS_TRIGGERED[0] = 0;
	JB_EGU->INTENSET = EGU_INTENSET_TRIGGERED0_Msk;
	IRQ_DIRECT_CONNECT(SWI5_EGU5_IRQn, 0, jb_target_isr, IRQ_ZERO_LATENCY);
	irq_enable(JB_EGU_IRQn);

	/* PWM1: reply generator on the data pin. */
	JB_PWM->ENABLE = 0;
	JB_PWM->PSEL.OUT[0] = p0_pin;               /* port 0, connected */
	JB_PWM->PSEL.OUT[1] = 0xFFFFFFFF;
	JB_PWM->PSEL.OUT[2] = 0xFFFFFFFF;
	JB_PWM->PSEL.OUT[3] = 0xFFFFFFFF;
	JB_PWM->MODE = PWM_MODE_UPDOWN_Up;
	JB_PWM->PRESCALER = PWM_PRESCALER_PRESCALER_DIV_1;  /* 16 MHz */
	JB_PWM->COUNTERTOP = PWM_TOP;
	JB_PWM->LOOP = 0;
	JB_PWM->DECODER = (PWM_DECODER_LOAD_Common << PWM_DECODER_LOAD_Pos) |
			  (PWM_DECODER_MODE_RefreshCount << PWM_DECODER_MODE_Pos);
	JB_PWM->SEQ[0].REFRESH = 0;
	JB_PWM->SEQ[0].ENDDELAY = 0;
	JB_PWM->SEQ[1].PTR = (uint32_t)s_id_reply;    /* unused, but valid */
	JB_PWM->SEQ[1].CNT = 0;
	/* SEQEND fires when the last value (the idle period) starts; STOP
	 * then takes effect at the end of that period. */
	JB_PWM->SHORTS = PWM_SHORTS_SEQEND0_STOP_Msk;
	JB_PWM->INTENSET = PWM_INTENSET_STOPPED_Msk;
	JB_PWM->ENABLE = 1;
	IRQ_CONNECT(PWM1_IRQn, 2, pwm_isr, NULL, 0);
	irq_enable(JB_PWM_IRQn);

	k_timer_start(&service_timer, K_MSEC(1), K_MSEC(1));
	rearm();
	return 0;
}
```

## src/link.h
```c
/*
 * Glue shared by main.c, radio.c and the role files (ptx.c / prx.c).
 * Packet formats live in gc_protocol.h.
 */
#ifndef LINK_H_
#define LINK_H_

#include <stdbool.h>
#include <stdint.h>
#include "gc_protocol.h"

/* radio.c; app_esb_handler() is defined by the role file (ptx.c / prx.c) */
struct esb_evt;
void app_esb_handler(const struct esb_evt *event);
int radio_init(bool prx);

/* main.c helpers */
void led_toggle(void);
void led_set(bool on);
void dbg_pin_set(bool on);
uint32_t us_now(void);      /* thread context */
uint32_t us_now_isr(void);  /* ESB event (ISR) context */

/* Role entry point: runs forever, prints stats once a second. */
void role_run(void);

/* Receiver side (prx.c): latest state received from the controller board. */
bool gc_rx_get_input(GC_Payload *out);    /* false if none or stale (>100 ms) */
bool gc_rx_get_origin(GC_Origin *out);    /* false if none received yet */

#endif
```

## src/radio.c
```c
/*
 * ESB setup shared by both roles. Both boards must agree on everything
 * here: address, channel (prj.conf), bitrate, protocol, ramp-up.
 */
#include <esb.h>
#include <zephyr/kernel.h>
#include "link.h"



int radio_init(bool prx)
{
	/* Private address so we don't talk to stray nRF24/ESB devices.
	 * Full address = 4-byte base + 1-byte pipe prefix. */
	static const uint8_t base_addr_0[4] = {0x47, 0x43, 0x4C, 0x4B}; /* "GCLK" */
	static const uint8_t prefixes[1] = {0xA5};

	struct esb_config config = ESB_DEFAULT_CONFIG;
	int err;

	config.protocol = ESB_PROTOCOL_ESB_DPL;   /* dynamic payload length */
	config.mode = prx ? ESB_MODE_PRX : ESB_MODE_PTX;
	config.event_handler = app_esb_handler;
	config.bitrate = ESB_BITRATE_2MBPS;
	config.crc = ESB_CRC_16BIT;
	config.tx_output_power = CONFIG_APP_TX_POWER;   /* dBm */
	config.retransmit_delay = CONFIG_APP_RETRANSMIT_DELAY_US;
	config.retransmit_count = CONFIG_APP_RETRANSMIT_COUNT;
	config.tx_mode = ESB_TXMODE_AUTO;         /* esb_write_payload() sends now */
	config.selective_auto_ack = true;
	/* Normal 130 us ramp-up, NOT fast (40 us). ESB's radio ISR must run
	 * within the ramp-up time after each packet, and on the receiver the
	 * Joybus target can hold interrupts off for ~100 us while it reads a
	 * console command. 130 us leaves room; 40 us would not. */
	config.use_fast_ramp_up = false;

	err = esb_init(&config);
	if (err) {
		return err;
	}
	err = esb_set_rf_channel(CONFIG_APP_RF_CHANNEL);
	if (err) {
		return err;
	}
	err = esb_set_base_address_0(base_addr_0);
	if (err) {
		return err;
	}
	/* One prefix = only pipe 0 enabled. */
	return esb_set_prefixes(prefixes, ARRAY_SIZE(prefixes));
}
```
